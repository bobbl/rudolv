/* UART for the Future Electronics Microsemi Creative Board is different from
 * other Microsemi MiV boards */

&uart0 {
        status = "okay";
        current-speed = <115200>;
        clock-frequency = <50000000>;
	reg = <0x70000000 0x1000>;
};
